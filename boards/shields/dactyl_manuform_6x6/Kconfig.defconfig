## boards/shields/dactyl_manuform_6x6/Kconfig.defconfig
```kconfig
if SHIELD_DACTYL_MANUFORM_6x6_LEFT

    config ZMK_KEYBOARD_NAME
        default "DM_6x6"

    config ZMK_SPLIT_BLE_ROLE_CENTRAL
        default y

endif

if SHIELD_DACTYL_MANUFORM_6x6_RIGHT

    config ZMK_KEYBOARD_NAME
        default "DM_6x6_R"

endif

if SHIELD_DACTYL_MANUFORM_6x6_LEFT || SHIELD_DACTYL_MANUFORM_6x6_RIGHT

    config ZMK_SPLIT
        default y

endif
```

## boards/shields/dactyl_manuform_6x6/Kconfig.shield
```kconfig
config SHIELD_DACTYL_MANUFORM_6x6_LEFT
    def_bool $(shields_list_contains,dactyl_manuform_6x6_left)
    select ZMK_STUDIO

config SHIELD_DACTYL_MANUFORM_6x6_RIGHT
    def_bool $(shields_list_contains,dactyl_manuform_6x6_right)
    select ZMK_STUDIO
```
